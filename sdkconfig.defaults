## sdkconfig.defaults
```kconfig
# Necessary for the LED screen demos
CONFIG_ESP_MAIN_TASK_STACK_SIZE=20000

CONFIG_ESP_SYSTEM_EVENT_TASK_STACK_SIZE=4096

# NAPT demo (router)
CONFIG_LWIP_L2_TO_L3_COPY=y
CONFIG_LWIP_IP_FORWARD=y
CONFIG_LWIP_IPV4_NAPT=y

# SPI Ethernet demo
CONFIG_ETH_SPI_ETHERNET_DM9051=y
CONFIG_ETH_SPI_ETHERNET_W5500=y
CONFIG_ETH_SPI_ETHERNET_KSZ8851SNL=y

# Bigger headers are necessary for the QEMU demo
CONFIG_HTTPD_MAX_URI_LEN=1024
CONFIG_HTTPD_MAX_REQ_HDR_LEN=2048

CONFIG_MBEDTLS_CERTIFICATE_BUNDLE=y
CONFIG_MBEDTLS_CERTIFICATE_BUNDLE_DEFAULT_FULL=y

# Future: proper back-trace for esp32c3
#CONFIG_ESP_SYSTEM_USE_EH_FRAME=y
```

## sdkconfig.defaults.esp32
```kconfig
# Disabled, because somehow causes issues when compiling for ESP32S2, where it is not supported.
# In theory, this `sdkconfig.defaults` file should not be picked up when ESP32S2 is the target, but it somehow does get picked up
#CONFIG_ETH_USE_OPENETH=y
#CONFIG_MBEDTLS_HARDWARE_AES=n
#CONFIG_MBEDTLS_HARDWARE_SHA=n
```

## sdkconfig.defaults.esp32s2-ulp-example
```kconfig
CONFIG_ESP32S2_ULP_COPROC_ENABLED=y
CONFIG_ESP32S2_ULP_COPROC_RESERVE_MEM=4096
CONFIG_ESP32S2_ULP_COPROC_RISCV=y

CONFIG_LWIP_L2_TO_L3_COPY=y
CONFIG_LWIP_IP_FORWARD=y
CONFIG_LWIP_IPV4_NAPT=y
```
